/*@!Encoding:1252*/
testfunction Switch_vehicle_to_driving_mode(int power_mode,int vehicle_speed)
{
  testWaitForTesterConfirmation("Turn Battery ON",1000);
  @sysvar::Ignstate=power_mode;
  testWaitForTimeout(1000);
  setSignal(BCMInfo::VehicleSpeed,vehicle_speed);
  testWaitForTimeout(1000);
 
}

testfunction Check_ACC_Standby_State(int vehicle_speed)
{
  Switch_vehicle_to_driving_mode(2,vehicle_speed);
  testValidateSignalMatch("Check ACC is OFF",ACCInfo::ACCState,0);
  testWaitForTimeout(1000);
  Press_cruise_sw(1);
  testWaitForTimeout(1000);
  testValidateSignalMatch("Check ACC is STANDBY",ACCInfo::ACCState,2);
}

testfunction Switch_vehicle_to_OFF_mode(int power_mode,int vehicle_speed)
{
  @sysvar::Ignstate=power_mode;
  testWaitForTimeout(1000);
  setSignal(BCMInfo::VehicleSpeed,vehicle_speed);
  testWaitForTimeout(1000);
 
}

testfunction chk_ACC_Active_State(int vehicle_speed)
{
  Switch_vehicle_to_driving_mode(2,vehicle_speed);
  testValidateSignalMatch("Check ACC is OFF",ACCInfo::ACCState,0);
  testWaitForTimeout(1000);
  Press_cruise_sw(1);
  testWaitForTimeout(1000);
  testValidateSignalMatch("Check ACC is STANDBY",ACCInfo::ACCState,2);
  Press_cruise_sw(2);
  testWaitForTimeout(1000);
  testValidateSignalMatch("Check ACC is ACTIVE",ACCInfo::ACCState,3);
}

testfunction Press_cruise_sw(int sw)
{
  setSignal(ICMInfo::CruiseSwitchRequest,sw);
  testWaitForTimeout(250);
  setSignal(ICMInfo::CruiseSwitchRequest,7);
}

testfunction Brake_Light_Ver()
{
  int result;
  result=testWaitForTesterConfirmation("Is Brake light ON?");
  if(result==1)
  {
    testStepPass("Brake light is ON");
  }
  else
  {
    testStepFail("Brake light is not ON");
  }
  result=testWaitForSignalMatch(ACCInfo::BrakeDecelReq,1,10000);
  if(result==1)
  {
    testStepPass("Brake light is ON");
  }
  else
  {
    testStepFail("Brake light is not ON"); 
  }
}

testfunction Read_DID(word DID)
{
  @sysvar::Diagnostic::DID_LSB=DID &0xff;
  DID=DID>>8;
  @sysvar::Diagnostic::DID_MSB=DID &0xff;
  @sysvar::Diagnostic::DID_Read=1;
  testWaitForTimeout(1000);
}

